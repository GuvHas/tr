## sdkconfig.defaults
```kconfig
# Target board and SoC
CONFIG_IDF_TARGET="esp32c6"

# OpenThread + Matter over Thread + BLE commissioning
CONFIG_OPENTHREAD_ENABLED=y
CONFIG_OPENTHREAD_FTD=y

# Pin OpenThread router-role thresholds explicitly so behaviour is documented
# and stable across SDK/OpenThread upgrades.
#
# MAX_ROUTERS=32: the Thread spec maximum; fine for any network size.
# ROUTER_UPGRADE_THRESHOLD=16: a REED promotes to Router when the active
#   router count is below this value. On a lone dev network the device will
#   still attempt promotion (expected for an FTD), but with this value pinned
#   the behaviour is deliberate and easy to reduce for MTD-style testing.
# ROUTER_DOWNGRADE_THRESHOLD=23: a Router steps down when the count exceeds
#   this value, preventing unnecessary multi-router churn on small networks.
CONFIG_OPENTHREAD_MAX_ROUTERS=32
CONFIG_OPENTHREAD_ROUTER_UPGRADE_THRESHOLD=16
CONFIG_OPENTHREAD_ROUTER_DOWNGRADE_THRESHOLD=23

# Persist Thread network credentials (key, PAN ID, channel) across reboots.
# Without this the Thread interface must be re-commissioned after every power cycle.
CONFIG_OPENTHREAD_NVS_PERSIST=y

# BLE discovery for commissioning
CONFIG_BT_ENABLED=y
CONFIG_BT_NIMBLE_ENABLED=y
CONFIG_ENABLE_CHIPOBLE=y

# Route all Matter credentials to the protected nvs_matter partition.
#
# FACTORY namespace: setup payload data (discriminator, PAKE verifier, device
#   attestation certs). Truly write-once after manufacture.
#
# CONFIG namespace: the CHIP fabric table (Root CA, NOC, operational keys) plus
#   ACL entries, group keys, and subscription state. The fabric table is written
#   once at commissioning but must survive any NVS recovery event — routing it to
#   the auto-erase nvs partition would cause silent fabric loss if nvs is ever
#   wiped for recovery (see app_main.cpp), requiring full re-commissioning.
#   Flash wear from ACL/subscription writes is acceptable for a prototype device
#   with few controllers and infrequent ACL changes.
#
# CONFIG_ESP_MATTER_NVS_PART_NAME: esp_matter-internal attribute persistence.
#   All three namespaces must be on nvs_matter to prevent any commissioning
#   state from being auto-erased during NVS recovery.
CONFIG_CHIP_FACTORY_NAMESPACE_PARTITION_LABEL="nvs_matter"
CONFIG_CHIP_CONFIG_NAMESPACE_PARTITION_LABEL="nvs_matter"
CONFIG_ESP_MATTER_NVS_PART_NAME="nvs_matter"

# OTA Software Update Requestor cluster: disabled because this partition table
# has no ota_0/ota_1 partitions. Advertising OTA capability without flash slots
# to stage an update would violate the Matter spec contract with controllers.
# To enable OTA: add ota_0, ota_1, and otadata partitions, then remove this line.
CONFIG_ENABLE_OTA_REQUESTOR=n

# Disable CHIP's WiFi NetworkCommissioning driver and WiFi station so that
# only the Thread NetworkCommissioning cluster is advertised to commissioners.
#
# Background: esp_matter::start() registers a NetworkCommissioning cluster for
# every network interface CHIP was compiled with. On ESP32-C6 both WiFi and
# Thread are supported in hardware, so without these settings CHIP registers
# both clusters and Home Assistant's matter-server picks WiFi over Thread even
# when a Thread Border Router is available.
#
# CONFIG_WIFI_NETWORK_COMMISSIONING_DRIVER=n
#   Removes the WiFi NetworkCommissioning cluster entirely. The commissioner
#   sees only Thread and is forced to push Thread credentials over BLE.
#   Defined in connectedhomeip/config/esp32/components/chip/Kconfig.
#
# CONFIG_ENABLE_WIFI_STATION=n
#   Prevents CHIP's device-layer from starting the WiFi station ("Starting
#   ESP WiFi layer"), eliminating the reconnect loop seen in the logs when
#   the commissioner still tries to connect via the now-absent WiFi cluster.
#   Defined in connectedhomeip/config/esp32/components/chip/Kconfig.
#
# BLE commissioning is unaffected: NimBLE uses the BLE controller driver
# independently of CHIP's WiFi station management.
CONFIG_WIFI_NETWORK_COMMISSIONING_DRIVER=n
CONFIG_ENABLE_WIFI_STATION=n

# FreeRTOS tick rate: 1000 Hz gives 1 ms resolution for MRP retransmission timers,
# Thread MLE timeouts, and Matter subscription reporting intervals.
# ESP32-C6 defaults to 100 Hz (10 ms resolution) which causes spurious retransmits
# under marginal RF conditions. pdMS_TO_TICKS() in app code is unaffected.
CONFIG_FREERTOS_HZ=1000

# Matter device product name shown in Home Assistant and other controllers.
CONFIG_DEVICE_PRODUCT_NAME="GH LK Control"

# Matter + logging defaults
CONFIG_ESP_MATTER_ENABLE_DATA_MODEL=y
# Canonical integer form for the log-level choice (2 = INFO)
CONFIG_LOG_DEFAULT_LEVEL=2
# Suppress OpenThread debug/info chatter; NOTE keeps join/detach events visible
CONFIG_OPENTHREAD_LOG_LEVEL_NOTE=y

# mbedTLS features required by esp_matter/CHIP
CONFIG_MBEDTLS_HKDF_C=y

# Custom partition table to fit larger Matter binaries
CONFIG_PARTITION_TABLE_CUSTOM=y
CONFIG_PARTITION_TABLE_CUSTOM_FILENAME="partitions.csv"

# Flash size (required by custom partition table)
CONFIG_ESPTOOLPY_FLASHSIZE_4MB=y

# Activate the 128 KB coredump partition defined in partitions.csv.
# ELF format allows the dump to be loaded directly into gdb via
# `idf.py coredump-info` / `idf.py coredump-debug`.
# Zero runtime overhead: the coredump handler only runs inside the panic path.
CONFIG_ESP_COREDUMP_ENABLE_TO_FLASH=y
CONFIG_ESP_COREDUMP_DATA_FORMAT_ELF=y

# app_main performs two nvs_flash_init_partition() calls and esp_matter::start()
# (mbedTLS init + OpenThread stack bringup) before vTaskDelete(nullptr).
# The Matter/Thread init path consumes 6-7 KB on ESP32-C6; the IDF default of
# 3584 bytes causes a stack overflow with no visible panic (canary fires after
# the fact). 8192 bytes provides sufficient headroom. The stack is released
# immediately when vTaskDelete(nullptr) is called at the end of app_main.
CONFIG_ESP_MAIN_TASK_STACK_SIZE=8192
```
